## main/Kconfig.projbuild
```kconfig
menu "Autumn's ESP32 Configuration"
    config ESP_WIFI_SSID
        string "WiFi SSID"
        help
            "SSID or network name to connect to"

    config ESP_WIFI_PASSWORD
        string "WiFi Password"
        help
            "Password of network to connect to (WPA or WPA2)"

    config ESP_HOSTNAME
        string "Hostname for device"
        default "autumns-esp32"

    config WEBSOCKET_URI
        string "Websocket to connect to"
        default "wss://chat.strims.gg/ws"

    config INFLUXDB_URI
        string "HTTP InfluxDB URI for posting data to, including basic auth"
        help 
            "Full URI: http://username:password@localhost:8086/api/v2/write?bucket=db/rp&precision=ns"

    config ENABLE_BME280_SENSOR
        bool "Enable BME280 sensor"
        default n

    config ENABLE_BME680_SENSOR
        bool "Enable BME680 sensor"
        default n
endmenu
```
